## base_external/package/char-driver/Config.in
```kconfig
config BR2_PACKAGE_CHAR_DRIVER
	bool "char-driver"
	help
	  Includes the aesdchar module in the kernel image.
	  Used to understand buildroot external trees and package builds.
```
